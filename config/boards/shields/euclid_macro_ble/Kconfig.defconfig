## config/boards/shields/euclid_macro_ble/Kconfig.defconfig
```kconfig
# Default configuration for euclid_macro_ble

if SHIELD_EUCLID_MACRO_BLE

# Name of the keyboard
config ZMK_KEYBOARD_NAME
    default "euclid_macro_ble"

endif
```

## config/boards/shields/euclid_macro_ble/Kconfig.shield
```kconfig
config SHIELD_EUCLID_MACRO_BLE
    def_bool $(shields_list_contains,euclid_macro_ble)
```
